## project/firmware/bootloader/Kconfig
```kconfig
source "$SIFLI_SDK/Kconfig.v2"
source "$SIFLI_SDK/customer/boards/Kconfig.v2"
source "D:/SIFLI/sifli-sdk/customer/boards/sf32lb52-nano_n16r16/hcpu/Kconfig.board"
osource "D:/SIFLI/sifli-sdk/example/boot_loader/project/butterflmicro/ram_v2/sf-pkgs/Kconfig.conandeps"
source "D:/SIFLI/sifli-sdk/example/boot_loader/project/butterflmicro/ram_v2/Kconfig.proj"
```

## project/firmware/ftab/Kconfig
```kconfig
source "$SIFLI_SDK/Kconfig.v2"
source "$SIFLI_SDK/customer/boards/Kconfig.v2"
source "D:/SIFLI/sifli-sdk/customer/boards/sf32lb52-nano_n16r16/hcpu/Kconfig.board"
osource "D:/SIFLI/sifli-sdk/example/flash_table/sf32lb52x_common_v2/sf-pkgs/Kconfig.conandeps"
source "D:/SIFLI/sifli-sdk/example/flash_table/sf32lb52x_common_v2/Kconfig.proj"
```
